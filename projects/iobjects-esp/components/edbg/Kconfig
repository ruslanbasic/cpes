## projects/iobjects-esp/components/edbg/Kconfig
```kconfig
menu "EDBG"

config EDBG_ENABLED
    bool "EDBG is used or not"
    default N

config EDBG_SWCLK_GPIO
    int "EDBG SWCLK GPIO"
    depends on EDBG_ENABLED
    range 0 33
    default 18

config EDBG_SWDIO_GPIO
    int "EDBG SWDIO GPIO"
    depends on EDBG_ENABLED
    range 0 33
    default 4

config EDBG_RESET_GPIO
    int "EDBG RESET GPIO"
    depends on EDBG_ENABLED
    range 0 33
    default 12

endmenu
```

## projects/iobjects-esp/components/esp-adf/audio_hal/Kconfig.projbuild
```kconfig
menu "Audio HAL"

choice AUDIO_BOARD
    prompt "Audio board"
    default A1_INTELLIGENT_BOARD
    help
        Select an audio board to use with the ESP-ADF

config A1_INTELLIGENT_BOARD
    bool "ESP32 Intelligent Object"
config ESP_LYRAT_V4_3_BOARD
    bool "ESP32-Lyrat V4.3"
config ESP_LYRAT_V4_2_BOARD
    bool "ESP32-Lyrat V4.2"
config ESP_LYRATD_MSC_V2_1_BOARD
    bool "ESP32-LyraTD-MSC V2.1"
config ESP_LYRATD_MSC_V2_2_BOARD
    bool "ESP32-LyraTD-MSC V2.2"
endchoice

endmenu
```

## projects/iobjects-esp/components/stpm3x/Kconfig
```kconfig
menu "STPM32"

config STPM32_ENABLED
    bool "STPM32 is used or not"
    default N

config STPM32_KSI_SHUNT_MILLIOHM
    int "KSI shunt in milliohm"
    range 1 100
    depends on STPM32_ENABLED
    default 5

config STPM32_CALIBRATION
    int "Calibration"
    range 1 150
    depends on STPM32_ENABLED
    default 96

endmenu
```

## projects/iobjects-esp/main/device/plug/hw-v6/sdkconfig.defaults
```kconfig
###############################################################################
# @copyright Copyright (c) A1 Company LLC. All rights reserved.
###############################################################################

CONFIG_BOOTLOADER_FACTORY_RESET=y
CONFIG_BOOTLOADER_NUM_PIN_FACTORY_RESET=36
CONFIG_BOOTLOADER_OTA_DATA_ERASE=y
CONFIG_BOOTLOADER_DATA_FACTORY_RESET="nvs"
CONFIG_BOOTLOADER_HOLD_TIME_GPIO=1

CONFIG_EDBG_ENABLED=y
CONFIG_EDBG_SWCLK_GPIO=4
CONFIG_EDBG_SWDIO_GPIO=18
CONFIG_EDBG_RESET_GPIO=12

CONFIG_STPM32_ENABLED=y
CONFIG_STPM32_KSI_SHUNT_MILLIOHM=1
CONFIG_STPM32_CALIBRATION=145

###############################################################################
```
